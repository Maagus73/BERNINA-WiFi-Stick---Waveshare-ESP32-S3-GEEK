"<!doctype html>\n"
"<html lang=\"de\"><head><meta charset=\"utf-8\"><meta name=\"viewport\" content=\"width=device-width,initial-scale=1\"><title>BERNINA WiFi Stick</title>\n"
"<style>:root{color-scheme:light dark;--accent:#9f1239}body{font:16px/1.55 system-ui,sans-serif;max-width:860px;margin:24px auto;padding:0 18px}h1{margin-bottom:0}header p{margin-top:2px;opacity:.7}section,details{border:1px solid #9996;border-radius:12px;padding:18px;margin:18px 0}summary{cursor:pointer;font-weight:650}button,input,select{font:inherit;padding:9px 12px;margin:5px 4px 5px 0;border:1px solid #9998;border-radius:6px}button{cursor:pointer}button:disabled{cursor:wait;opacity:.45}button.primary{background:var(--accent);color:white}label{display:inline-block}#notice{padding:10px;border-left:3px solid var(--accent);min-height:1.5em}#state{font-size:1.2em;font-weight:700}#events{max-height:440px;overflow:auto;white-space:pre-wrap;font:13px/1.6 ui-monospace,monospace;border:1px solid #9996;padding:12px}progress{width:100%;accent-color:var(--accent)}.muted{opacity:.75}.error{color:#dc2626}.row{display:flex;align-items:center;gap:10px;flex-wrap:wrap}footer{font-size:.85em;opacity:.7;margin:24px 0}</style></head>\n"
"<body><header><h1>BERNINA WiFi Stick</h1><p>Version 1.0.3</p></header>\n"
"<section aria-live=\"polite\"><div id=\"state\">BERNINA WiFi Stick: Status wird geladen …</div><p id=\"network\"></p><p id=\"timer\"></p><p id=\"inventory\"></p><p id=\"last\"></p><div id=\"transfer\" hidden><progress id=\"progress\" max=\"100\" value=\"0\"></progress><span id=\"progressText\"></span></div><p id=\"recovery\"></p><p id=\"health\" class=\"muted\"></p></section>\n"
"<details id=\"actions\"><summary>BERNINA WiFi Stick - Aktionen</summary><p><label>Passwort: <input id=\"password\" type=\"password\" autocomplete=\"off\" maxlength=\"128\"></label></p><p id=\"notice\" role=\"status\">Passwort für Aktionen und Berichte eingeben.</p>\n"
"<div class=\"row\"><button data-write onclick=\"action('app')\">APP übernehmen</button><button class=\"primary\" data-write data-app onclick=\"action('sync')\">Jetzt abgleichen</button><button data-write onclick=\"action('pause')\">Automatik pausieren</button><button data-write onclick=\"action('resume')\">Automatik fortsetzen</button><button data-write onclick=\"action('repair')\">Spiegel reparieren</button><button data-write data-usb onclick=\"action('usb')\">USB anmelden</button></div>\n"
"<p><label><input data-write id=\"screensaver\" type=\"checkbox\" onchange=\"screensaver()\"> Bildschirmschoner (Matrix)</label></p>\n"
"<details><summary>Konfiguration</summary><p>Abgleichintervall – ohne Neustart übernehmen:</p><div class=\"row\"><input id=\"interval\" type=\"number\" min=\"1\" max=\"10080\" step=\"1\" aria-label=\"Intervall\"><select id=\"unit\" aria-label=\"Einheit\"><option value=\"minutes\">Minuten</option><option value=\"hours\">Stunden</option></select><button data-write onclick=\"saveConfig()\">Speichern</button><button onclick=\"reloadConfig()\">Vom Stick laden</button></div><p class=\"muted\">1 Minute bis 7 Tage. Ein laufender Auftrag wird nicht unterbrochen.</p><p><label><input type=\"checkbox\" id=\"retryEnabled\"> NAS-Ausfälle automatisch erneut versuchen</label></p><p>Wartezeiten in Sekunden (1., 2., 3. und weitere Versuche):</p><div class=\"row\"><input id=\"retry0\" type=\"number\" min=\"1\" max=\"86400\" aria-label=\"Wartezeit 1\" style=\"width:6em\"><input id=\"retry1\" type=\"number\" min=\"1\" max=\"86400\" aria-label=\"Wartezeit 2\" style=\"width:6em\"><input id=\"retry2\" type=\"number\" min=\"1\" max=\"86400\" aria-label=\"Wartezeit 3\" style=\"width:6em\"><input id=\"retry3\" type=\"number\" min=\"1\" max=\"86400\" aria-label=\"Wartezeit 4\" style=\"width:6em\"><button data-write onclick=\"saveRetry()\">Wiederaufnahme speichern</button></div><p class=\"muted\">Standard: 30, 60, 120, 300 Sekunden. Eine manuelle Pause bleibt erhalten. Zertifikats-, Zugangs- und SD-Fehler benötigen eine Prüfung.</p><button data-write onclick=\"action('reboot')\">Gerät neu starten</button></details></details>\n"
"<details id=\"reports\"><summary>Berichte</summary><h2>Ereignisprotokoll</h2><p id=\"logInfo\" class=\"muted\">Heutiger Tag, Schweizer Ortszeit. Laden beim Öffnen oder über „Aktualisieren“.</p><button id=\"logRefresh\" onclick=\"loadEvents()\">Aktualisieren</button><button id=\"logDownload\" disabled onclick=\"downloadEvents()\">Tagesprotokoll herunterladen</button><pre id=\"events\" tabindex=\"0\">Noch nicht geladen.</pre></details>\n"
"<footer>Stick und NAS bilden einen Spiegel. Bei einem unterbrochenen Sync bleibt USB gesperrt; „Spiegel reparieren“ prüft und ergänzt den Bestand.</footer>\n"
"<script>\n"
